## conf/layer.conf
```bitbake
# Layer configuration
BBPATH .= ":${LAYERDIR}"

# Look for .bb files in recipes/ folder and subdirectories
BBFILES += "${LAYERDIR}/recipes/*.bb \
            ${LAYERDIR}/recipes*/*.bb \
            ${LAYERDIR}/recipes*/*.bbappend \
            ${LAYERDIR}/recipes*/*/*.bb \
            ${LAYERDIR}/recipes*/*/*.bbappend \
            ${LAYERDIR}/recipes*/*/*/*.bb \
            ${LAYERDIR}/recipes*/*/*/*.bbappend"

BBFILE_COLLECTIONS += "jvideo-pipeline"
BBFILE_PATTERN_jvideo-pipeline = "^${LAYERDIR}/"
BBFILE_PRIORITY_jvideo-pipeline = "10"

# Layer dependencies and compatibility
LAYERDEPENDS_jvideo-pipeline = "core"
LAYERSERIES_COMPAT_jvideo-pipeline = "kirkstone"

# Accept necessary licenses for commercial codecs
LICENSE_FLAGS_ACCEPTED = "commercial"

# FFmpeg configuration - use valid PACKAGECONFIG options for Kirkstone
PACKAGECONFIG:append:pn-ffmpeg = " \
    gpl \
    openssl \
"

# Use EXTRA_OECONF for codec-specific options instead
EXTRA_OECONF:append:pn-ffmpeg = " \
    --enable-libmp3lame \
    --enable-libx264 \
    --enable-libx265 \
    --enable-libvpx \
    --enable-nonfree \
"

# Enable FFmpeg support in OpenCV - force rebuild
PACKAGECONFIG:append:pn-opencv = " ffmpeg"
DEPENDS:append:pn-opencv = " ffmpeg"

# Ensure GStreamer support in OpenCV (if needed)
PACKAGECONFIG:append:pn-opencv = " gstreamer"

# ZeroMQ optimization
EXTRA_OECONF:append:pn-zeromq = " \
    --disable-curve \
    --without-docs \
    --enable-drafts=no \
"
```
